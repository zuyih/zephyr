## boards/alientek/dmra8t2/Kconfig.defconfig
```kconfig
# Copyright (c) 2026 Alientek
# SPDX-License-Identifier: Apache-2.0

if BOARD_DMRA8T2

configdefault NET_L2_ETHERNET
	default y

endif # BOARD_DMRA8T2
```

## boards/alientek/dmra8t2/Kconfig.dmra8t2
```kconfig
# Copyright (c) 2026 Alientek
# SPDX-License-Identifier: Apache-2.0

config BOARD_DMRA8T2
	select SOC_R7KA8T2LFLCAC_CM85 if BOARD_DMRA8T2_R7KA8T2LFLCAC_CM85
	select SOC_R7KA8T2LFLCAC_CM33 if BOARD_DMRA8T2_R7KA8T2LFLCAC_CM33
```

## boards/alientek/dmra8t2/board.yml
```yaml
board:
  name: dmra8t2
  full_name: ATK-DMRA8T2 Motor Control Board
  vendor: alientek
  socs:
  - name: r7ka8t2lflcac
```

## boards/nxp/frdm_kw24d512/board.yml
```yaml
board:
  name: frdm_kw24d512
  full_name: FRDM-KW24D512
  vendor: nxp
  socs:
    - name: mkw24d5
```

## boards/nxp/frdm_mcxc041/board.yml
```yaml
board:
  name: frdm_mcxc041
  full_name: FRDM-MCXC041
  vendor: nxp
  socs:
    - name: mcxc041
```

## boards/renesas/fpb_ra4e2/board.yml
```yaml
board:
  name: fpb_ra4e2
  full_name: RA4E2 Fast Prototyping Board
  vendor: renesas
  socs:
  - name: r7fa4e2b93cfm
```

## boards/st/nucleo_h5e5zj/Kconfig.defconfig
```kconfig
# STM32H5E5ZJ Nucleo board configuration

# Copyright The Zephyr Project Contributors
# SPDX-License-Identifier: Apache-2.0

if BOARD_NUCLEO_H5E5ZJ

configdefault NET_L2_ETHERNET
	default y

endif # BOARD_NUCLEO_H5E5ZJ
```

## boards/st/nucleo_h5e5zj/board.yml
```yaml
board:
  name: nucleo_h5e5zj
  full_name: Nucleo H5E5ZJ
  vendor: st
  socs:
    - name: stm32h5e5xx
```
